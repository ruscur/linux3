## Documentation/devicetree/bindings/powerpc/4xx/apm,apm82181.yaml
```yaml
# SPDX-License-Identifier: GPL-2.0-only OR BSD-2-Clause
%YAML 1.2
---
$id: http://devicetree.org/schemas/powerpc/4xx/apm,apm82181.yaml#
$schema: http://devicetree.org/meta-schemas/core.yaml#

title: APM APM82181 device tree bindings

description:
  AppliedMicro APM82181 Wi-Fi/network SoCs based
  on the PPC464-CPU architecture.

maintainers:
  - Christian Lamparter <chunkeey@gmail.com>

properties:
  $nodename:
    const: '/'
  compatible:
    oneOf:
      - description: APM82181 based boards
        items:
          - enum:
              - apm,bluestone
              - meraki,mr24
              - wd,mybooklive
          - const: amcc,apm82181

...
```

## Documentation/devicetree/bindings/powerpc/ibm,vas.txt
```
* IBM Powerpc Virtual Accelerator Switchboard (VAS)

VAS is a hardware mechanism that allows kernel subsystems and user processes
to directly submit compression and other requests to Nest accelerators (NX)
or other coprocessors functions.

Required properties:
- compatible : should be "ibm,vas".
- ibm,vas-id : A unique identifier for each instance of VAS in the system
- reg : Should contain 4 pairs of 64-bit fields specifying the Hypervisor
  window context start and length, OS/User window context start and length,
  "Paste address" start and length, "Paste window id" start bit and number
  of bits)
- ibm,vas-port : Port address for the interrupt.
- interrupts: IRQ value for each VAS instance and level.

Example:

	vas@6019100000000 {
		compatible = "ibm,vas", "ibm,power9-vas";
		reg = <0x6019100000000 0x2000000 0x6019000000000 0x100000000 0x8000000000000 0x100000000 0x20 0x10>;
		name = "vas";
		interrupts = <0x1f 0>;
		interrupt-parent = <&mpic>;
		ibm,vas-id = <0x1>;
		ibm,vas-port = <0x6010001000000>;
	};
```

## Documentation/devicetree/bindings/sound/fsl,easrc.yaml
```yaml
# SPDX-License-Identifier: GPL-2.0
%YAML 1.2
---
$id: http://devicetree.org/schemas/sound/fsl,easrc.yaml#
$schema: http://devicetree.org/meta-schemas/core.yaml#

title: NXP Asynchronous Sample Rate Converter (ASRC) Controller

maintainers:
  - Shengjiu Wang <shengjiu.wang@nxp.com>

properties:
  $nodename:
    pattern: "^easrc@.*"

  compatible:
    oneOf:
      - items:
        - enum:
          - fsl,imx8mn-easrc
  reg:
    maxItems: 1

  interrupts:
    maxItems: 1

  clocks:
    items:
      - description: Peripheral clock

  clock-names:
    items:
      - const: mem

  dmas:
    maxItems: 8

  dma-names:
    oneOf:
      - items:
          - const: ctx0_rx
          - const: ctx0_tx
          - const: ctx1_rx
          - const: ctx1_tx
          - const: ctx2_rx
          - const: ctx2_tx
          - const: ctx3_rx
          - const: ctx3_tx

  fsl,easrc-ram-script-name:
    $ref: /schemas/types.yaml#/definitions/string
    description: The coefficient table for the filters

  fsl,asrc-rate:
    $ref: /schemas/types.yaml#/definitions/uint32
    description: Defines a mutual sample rate used by DPCM Back Ends

  fsl,asrc-width:
    $ref: /schemas/types.yaml#/definitions/uint32
    description: Defines a mutual sample width used by DPCM Back Ends

required:
  - compatible
  - reg
  - interrupts
  - clocks
  - clock-names
  - dmas
  - dma-name
  - fsl,easrc-ram-script-name
  - fsl,asrc-rate
  - fsl,asrc-width

examples:
  - |
    #include <dt-bindings/clock/imx8mn-clock.h>

    easrc: easrc@300C0000 {
           compatible = "fsl,imx8mn-easrc";
           reg = <0x0 0x300C0000 0x0 0x10000>;
           interrupts = <0x0 122 0x4>;
           clocks = <&clk IMX8MN_CLK_ASRC_ROOT>;
           clock-names = "mem";
           dmas = <&sdma2 16 23 0> , <&sdma2 17 23 0>,
                  <&sdma2 18 23 0> , <&sdma2 19 23 0>,
                  <&sdma2 20 23 0> , <&sdma2 21 23 0>,
                  <&sdma2 22 23 0> , <&sdma2 23 23 0>;
           dma-names = "ctx0_rx", "ctx0_tx",
                       "ctx1_rx", "ctx1_tx",
                       "ctx2_rx", "ctx2_tx",
                       "ctx3_rx", "ctx3_tx";
           fsl,easrc-ram-script-name = "imx/easrc/easrc-imx8mn.bin";
           fsl,asrc-rate  = <8000>;
           fsl,asrc-width = <16>;
           status = "disabled";
    };
```

## Documentation/devicetree/bindings/usb/usb-hcd.yaml
```yaml
# SPDX-License-Identifier: GPL-2.0
%YAML 1.2
---
$id: http://devicetree.org/schemas/usb/usb-hcd.yaml#
$schema: http://devicetree.org/meta-schemas/core.yaml#

title: Generic USB Host Controller Device Tree Bindings

maintainers:
  - Greg Kroah-Hartman <gregkh@linuxfoundation.org>

properties:
  $nodename:
    pattern: "^usb(@.*)?"

  phys:
    $ref: /schemas/types.yaml#/definitions/phandle-array
    description:
      List of all the USB PHYs on this HCD

  phy-names:
    description:
      Name specifier for the USB PHY

  maximum-speed:
   description:
     Tells USB controllers we want to work up to a certain speed. In case this
     isn't passed via DT, USB controllers should default to their maximum HW
     capability.
   $ref: /schemas/types.yaml#/definitions/string
   enum:
     - low-speed
     - full-speed
     - high-speed
     - super-speed
     - super-speed-plus

  dr_mode:
    description:
      Tells Dual-Role USB controllers that we want to work on a particular
      mode. In case this attribute isn't passed via DT, USB DRD controllers
      should default to OTG.
    $ref: /schemas/types.yaml#/definitions/string
    enum: [host, peripheral, otg]

  phy_type:
    description:
      Tells USB controllers that we want to configure the core to support a
      UTMI+ PHY with an 8- or 16-bit interface if UTMI+ is selected. In case
      this isn't passed via DT, USB controllers should default to HW
      capability.
    $ref: /schemas/types.yaml#/definitions/string
    enum: [utmi, utmi_wide]

  otg-rev:
    description:
      Tells usb driver the release number of the OTG and EH supplement with
      which the device and its descriptors are compliant, in binary-coded
      decimal (i.e. 2.0 is 0200H). This property is used if any real OTG
      features (HNP/SRP/ADP) is enabled. If ADP is required, otg-rev should be
      0x0200 or above.
    $ref: /schemas/types.yaml#/definitions/uint32

  companion:
    description: Phandle of a companion device
    $ref: /schemas/types.yaml#/definitions/phandle

  hnp-disable:
    description:
      Tells OTG controllers we want to disable OTG HNP. Normally HNP is the
      basic function of real OTG except you want it to be a srp-capable only B
      device.
    type: boolean

  srp-disable:
    description:
      Tells OTG controllers we want to disable OTG SRP. SRP is optional for OTG
      device.
    type: boolean

  adp-disable:
    description:
      Tells OTG controllers we want to disable OTG ADP. ADP is optional for OTG
      device.
    type: boolean

  usb-role-switch:
    description:
      Indicates that the device is capable of assigning the USB data role
      (USB host or USB device) for a given USB connector, such as Type-C,
      Type-B(micro). See connector/usb-connector.yaml.

  role-switch-default-mode:
    description:
      Indicates if usb-role-switch is enabled, the device default operation
      mode of controller while usb role is USB_ROLE_NONE.
    $ref: /schemas/types.yaml#/definitions/string
    enum: [host, peripheral]
    default: peripheral

examples:
  - |
    usb {
        phys = <&usb2_phy1>, <&usb3_phy1>;
        phy-names = "usb";
    };
  - |
    usb@4a030000 {
        compatible = "snps,dwc3";
        reg = <0x4a030000 0xcfff>;
        interrupts = <0 92 4>;
        usb-phy = <&usb2_phy>, <&usb3_phy>;
        maximum-speed = "super-speed";
        dr_mode = "otg";
        phy_type = "utmi_wide";
        otg-rev = <0x0200>;
        adp-disable;
    };
```

## arch/powerpc/platforms/powernv/pmem/Kconfig
```kconfig
# SPDX-License-Identifier: GPL-2.0-only
if LIBNVDIMM

config OCXL_PMEM
	tristate "OpenCAPI Persistent Memory"
	depends on LIBNVDIMM && PPC_POWERNV && PCI && EEH && ZONE_DEVICE && OCXL
	help
	  Exposes devices that implement the OpenCAPI Storage Class Memory
	  specification as persistent memory regions. You may also want
	  DEV_DAX, DEV_DAX_PMEM & FS_DAX if you plan on using DAX devices
	  stacked on top of this driver.

	  Select N if unsure.

config OCXL_PMEM_DEBUG
	bool "OpenCAPI Persistent Memory debugging"
	depends on OCXL_PMEM
	help
	  Enables low level IOCTLs for OpenCAPI Persistent Memory firmware development

endif
```

## drivers/nvdimm/ocxl/Kconfig
```kconfig
# SPDX-License-Identifier: GPL-2.0-only
if LIBNVDIMM

config OCXL_SCM
	tristate "OpenCAPI Storage Class Memory"
	depends on LIBNVDIMM && PPC_POWERNV && PCI && EEH
	select ZONE_DEVICE
	select OCXL
	help
	  Exposes devices that implement the OpenCAPI Storage Class Memory
	  specification as persistent memory regions.

	  Select N if unsure.

config OCXL_SCM_DEBUG
	bool "OpenCAPI Storage Class Memory debugging"
	depends on OCXL_SCM
	help
	  Enables low level IOCTLs for OpenCAPI SCM firmware development

endif
```
